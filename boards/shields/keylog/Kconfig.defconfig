## boards/shields/keylog/Kconfig.defconfig
```kconfig
if SHIELD_KEYLOG

config DISPLAY
    default y

config DISPLAY_INIT_PRIORITY
    default 90

endif
```

## boards/shields/keylog/Kconfig.shield
```kconfig
config SHIELD_KEYLOG_LEFT
    def_bool $(shields_list_contains,keylog_left)

config SHIELD_KEYLOG_RIGHT
    def_bool $(shields_list_contains,keylog_right)

config SHIELD_KEYLOG
    def_bool $(shields_list_contains,keylog)
```
