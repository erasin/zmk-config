/ {
    display: ssd1306_128x32 {
        compatible = "ssd1306,128x32", "zmk,display";
        width = <128>;
        height = <32>;
    };

    input_text_widget {
        compatible = "zmk,display-input-text-widget";
        display = <&display>;
        row = <16>;           // 显示在屏幕顶部
        col = <28>;           // 左侧起始
        max_chars = <16>;    // 依据你的屏幕宽度调整
    };
};
